## Kconfig
```kconfig
# SPDX-License-Identifier: GPL-2.0-only
# =========================================================================
# KiloOS Main Kconfig - Root Configuration Menu
# =========================================================================

mainmenu "KiloOS Kernel Configuration"

config KILOOS_VERSION
    string "KiloOS Version"
    default "0.1"

config X86_64_ARCH
    bool
    default y
    help
      Target Arch to x86_64 UEFI Class 3.


source "Src/Bootloader/Kconfig"
source "Src/Loader-Init/Kconfig"
source "Kernel/Kconfig"
```

## Kernel/Kconfig
```kconfig
# SPDX-License-Identifier: GPL-2.0-only
# =========================================================================
# KiloOS Kernel Configuration - Core Subsystem
# =========================================================================

menu "Kernel Core & Subsystems"

config KILOOS_KERNEL
    bool "Enable KiloOS Core Kernel"
    default y
    help
      Core execution layer of KiloOS, handling protected mode,
      higher-half mapping, and system initialization.

config SCHEDULER_MULTIPROCESSING
    bool "Enable Advanced Process Scheduler"
    depends on KILOOS_KERNEL
    default y
    help
      Enables the process scheduler supporting priority queues,
      time slices, and process state transitions (Running, Blocked, Waiting).

config JFILE_FS_SUPPORT
    bool "Enable Native JFile-FS Support"
    depends on KILOOS_KERNEL
    default y
    help
      Enables support for the native JFile-FS file system layout,
      responsible for parsing .pxe binaries and module paths.

endmenu
```

## Src/Bootloader/Kconfig
```kconfig
# SPDX-License-Identifier: GPL-2.0-only
# =========================================================================
# KiloOS Bootloader Configuration - UEFI Class 3 Subsystem
# =========================================================================

menu "Bootloader Subsystem (UEFI)"

config KILOOS_BOOTLOADER
    bool "Enable UEFI Bootloader (myboot.efi)"
    default y
    help
      Enables the primary UEFI bootloader responsible for initializing
      hardware services, parsing GOP graphics, and loading the secondary loader.

config UEFI_CLASS_3_SUPPORT
    bool "Force UEFI Class 3 (No CSM / Modern UEFI)"
    depends on KILOOS_BOOTLOADER
    default y
    help
      Configures the bootloader strictly for UEFI Class 3 environments,
      bypassing legacy BIOS compatibility (CSM).

endmenu
```

## Src/Loader-Init/Kconfig
```kconfig
# SPDX-License-Identifier: GPL-2.0-only
# =========================================================================
# KiloOS Loader Configuration - Initial Loader & Boot Subsystem
# =========================================================================

menu "Loader & Initialization Subsystem"

config KILOOS_SECONDARY_LOADER
    bool "Enable Secondary Loader (kiloos-krnl.pxe)"
    default y
    help
      Enables the secondary loader responsible for environment setup,
      parsing the PXE 1KB header, and handing execution over to the main kernel.

config PXE_HEADER_VERSION
    string "Default PXE Binary Header Version"
    depends on KILOOS_SECONDARY_LOADER
    default "0.1"
    help
      Specifies the version string injected into the 1KB PXE header block
      at offset 0x08 during the build process.

config PXE_HEADER_LICENSE
    string "Default PXE Binary Header License"
    depends on KILOOS_SECONDARY_LOADER
    default "gpl-2.0-only"
    help
      Specifies the license string injected into the 1KB PXE header block
      at offset 0x00 during the build process.

endmenu
```
